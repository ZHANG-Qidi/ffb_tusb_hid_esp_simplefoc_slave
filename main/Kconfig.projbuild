## main/Kconfig.projbuild
```kconfig
orsource "$IDF_PATH/examples/common_components/env_caps/$IDF_TARGET/Kconfig.env_caps"
menu "FFB Configuration"
    menu "FFB UART Configuration"
        config FFB_UART_PORT_NUM
            int "UART port number"
            range 0 2 if IDF_TARGET_ESP32 || IDF_TARGET_ESP32S3
            default 2 if IDF_TARGET_ESP32 || IDF_TARGET_ESP32S3
            range 0 1 if IDF_TARGET_ESP32S2
            default 1 if IDF_TARGET_ESP32S2
            help
                UART communication port number for the FFB.
                See UART documentation for available port numbers.
        config FFB_UART_BAUD_RATE
            int "UART communication speed"
            range 1200 921600
            default 115200
            help
                UART communication speed.
        config FFB_UART_TXD
            int "UART TXD pin number"
            range ENV_GPIO_RANGE_MIN ENV_GPIO_OUT_RANGE_MAX
            default 17 if IDF_TARGET_ESP32
            default 17 if IDF_TARGET_ESP32S2 || IDF_TARGET_ESP32S3
            help
                GPIO number for UART TX pin. See UART documentation for more information
                about available pin numbers for UART.
        config FFB_UART_RXD
            int "UART RXD pin number"
            range ENV_GPIO_RANGE_MIN ENV_GPIO_IN_RANGE_MAX
            default 16 if IDF_TARGET_ESP32
            default 18 if IDF_TARGET_ESP32S2 || IDF_TARGET_ESP32S3
            help
                GPIO number for UART RX pin. See UART documentation for more information
                about available pin numbers for UART.
        config FFB_UART_TASK_STACK_SIZE
            int "FFB UART task stack size"
            range 1024 16384
            default 4096
            help
                Defines stack size for FFB UART. Insufficient stack size can cause crash.
    endmenu
    menu "FFB ESPNOW Configuration"
        choice ESPNOW_WIFI_MODE
            prompt "WiFi mode"
            default ESPNOW_WIFI_MODE_STATION
            help
                WiFi mode(station or softap).
            config ESPNOW_WIFI_MODE_STATION
                bool "Station"
            config ESPNOW_WIFI_MODE_STATION_SOFTAP
                bool "Softap"
        endchoice
        config ESPNOW_PMK
            string "ESPNOW primary master key"
            default "pmk1234567890123"
            help
                ESPNOW primary master for the example to use. The length of ESPNOW primary master must be 16 bytes.
        config ESPNOW_LMK
            string "ESPNOW local master key"
            default "lmk1234567890123"
            help
                ESPNOW local master for the example to use. The length of ESPNOW local master must be 16 bytes.
        config ESPNOW_CHANNEL
            int "Channel"
            default 1
            range 0 14
            help
                The channel on which sending and receiving ESPNOW data.
        config ESPNOW_SEND_DELAY
            int "Send delay"
            default 500
            range 0 65535
            help
                Delay between sending two ESPNOW data, unit: ms.
        config ESPNOW_SEND_LEN
            int "Send len"
            range 10 1470
            default 64
            help
                Length of ESPNOW data to be sent, unit: byte.
        config ESPNOW_ENABLE_LONG_RANGE
            bool "Enable Long Range"
            default "n"
            help
                When enable long range, the PHY rate of ESP32 will be 512Kbps or 256Kbps
        config ESPNOW_ENABLE_POWER_SAVE
            bool "Enable ESPNOW Power Save"
            default "n"
            select ESP_WIFI_STA_DISCONNECTED_PM_ENABLE
            depends on ESPNOW_WIFI_MODE_STATION
            help
                With ESPNOW power save enabled, chip would be able to wakeup and sleep periodically
                Notice ESP_WIFI_STA_DISCONNECTED_PM_ENABLE is essential at Wi-Fi disconnected
        config ESPNOW_WAKE_WINDOW
            int "ESPNOW wake window, unit in millisecond"
            range 0 65535
            default 50
            depends on ESPNOW_ENABLE_POWER_SAVE
            help
                ESPNOW wake window
        config ESPNOW_WAKE_INTERVAL
            int "ESPNOW wake interval, unit in millisecond"
            range 1 65535
            default 100
            depends on ESPNOW_ENABLE_POWER_SAVE
            help
                ESPNOW wake interval
    endmenu
endmenu
menu "Arduino Core Configuration"
    menu "Arduino Core UART Configuration"
        config ARDUINO_UART_PORT_NUM
            int "UART port number"
            range 0 2 if IDF_TARGET_ESP32 || IDF_TARGET_ESP32S3
            default 0 if IDF_TARGET_ESP32 || IDF_TARGET_ESP32S3
            range 0 1 if IDF_TARGET_ESP32S2
            default 0 if IDF_TARGET_ESP32S2
            help
                UART communication port number for the Arduino Core.
                See UART documentation for available port numbers.
        config ARDUINO_UART_BAUD_RATE
            int "UART communication speed"
            range 1200 921600
            default 115200
            help
                UART communication speed.
        config ARDUINO_UART_TXD
            int "UART TXD pin number"
            range ENV_GPIO_RANGE_MIN ENV_GPIO_OUT_RANGE_MAX
            default 1 if IDF_TARGET_ESP32
            default 43 if IDF_TARGET_ESP32S2 || IDF_TARGET_ESP32S3
            help
                GPIO number for UART TX pin. See UART documentation for more information
                about available pin numbers for UART.
        config ARDUINO_UART_RXD
            int "UART RXD pin number"
            range ENV_GPIO_RANGE_MIN ENV_GPIO_IN_RANGE_MAX
            default 3 if IDF_TARGET_ESP32
            default 44 if IDF_TARGET_ESP32S2 || IDF_TARGET_ESP32S3
            help
                GPIO number for UART RX pin. See UART documentation for more information
                about available pin numbers for UART.
    endmenu
    menu "Arduino Core I2C Configuration"
        config ARDUINO_I2C_HOST_NUM
            int "I2C port number"
            range 0 1 if IDF_TARGET_ESP32 || IDF_TARGET_ESP32S2 || IDF_TARGET_ESP32S3
            default 0 if IDF_TARGET_ESP32 || IDF_TARGET_ESP32S2 || IDF_TARGET_ESP32S3
            help
                I2C communication port number for the Arduino Core.
                See I2C documentation for available port numbers.
        config ARDUINO_IIC_SCL
            int "IIC_SCL pin number"
            range ENV_GPIO_RANGE_MIN ENV_GPIO_IN_RANGE_MAX
            default 22 if IDF_TARGET_ESP32
            default 1 if IDF_TARGET_ESP32S2 || IDF_TARGET_ESP32S3
            help
                GPIO number for IIC_SCL
        config ARDUINO_IIC_SDA
            int "IIC_SDA pin number"
            range ENV_GPIO_RANGE_MIN ENV_GPIO_IN_RANGE_MAX
            default 21 if IDF_TARGET_ESP32
            default 2 if IDF_TARGET_ESP32S2 || IDF_TARGET_ESP32S3
            help
                GPIO number for IIC_SDA
    endmenu
    menu "Arduino Core SPI Configuration"
        config ARDUINO_SPI_HOST_NUM
            int "SPI port number"
            range 0 2 if IDF_TARGET_ESP32S2 || IDF_TARGET_ESP32S3
            default 2 if IDF_TARGET_ESP32S2 || IDF_TARGET_ESP32S3
            range 0 2 if IDF_TARGET_ESP32
            default 2 if IDF_TARGET_ESP32
            help
                SPI communication port number for the Arduino Core.
                See SPI documentation for available port numbers.
        config ARDUINO_SPI_CS0
            int "SPI_CS0 pin number"
            range ENV_GPIO_RANGE_MIN ENV_GPIO_IN_RANGE_MAX
            default 5 if IDF_TARGET_ESP32
            default 10 if IDF_TARGET_ESP32S2 || IDF_TARGET_ESP32S3
            help
                GPIO number for SPI_CS0
        config ARDUINO_SPI_MISO
            int "SPI_MISO pin number"
            range ENV_GPIO_RANGE_MIN ENV_GPIO_IN_RANGE_MAX
            default 19 if IDF_TARGET_ESP32
            default 13 if IDF_TARGET_ESP32S2 || IDF_TARGET_ESP32S3
            help
                GPIO number for SPI_MISO
        config ARDUINO_SPI_MOSI
            int "SPI_MOSI pin number"
            range ENV_GPIO_RANGE_MIN ENV_GPIO_IN_RANGE_MAX
            default 23 if IDF_TARGET_ESP32
            default 11 if IDF_TARGET_ESP32S2 || IDF_TARGET_ESP32S3
            help
                GPIO number for SPI_MOSI
        config ARDUINO_SPI_CLK
            int "SPI_CLK pin number"
            range ENV_GPIO_RANGE_MIN ENV_GPIO_IN_RANGE_MAX
            default 18 if IDF_TARGET_ESP32
            default 12 if IDF_TARGET_ESP32S2 || IDF_TARGET_ESP32S3
            help
                GPIO number for SPI_CLK
    endmenu
endmenu
menu "Simple FOC Configuration"
    config FOC_MOTOR_U
        int "MOTOR_U pin number"
        range ENV_GPIO_RANGE_MIN ENV_GPIO_IN_RANGE_MAX
        default 14 if IDF_TARGET_ESP32
        default 42 if IDF_TARGET_ESP32S2 || IDF_TARGET_ESP32S3
        help
            GPIO number for MOTOR_U
    config FOC_MOTOR_V
        int "MOTOR_V pin number"
        range ENV_GPIO_RANGE_MIN ENV_GPIO_IN_RANGE_MAX
        default 12 if IDF_TARGET_ESP32
        default 41 if IDF_TARGET_ESP32S2 || IDF_TARGET_ESP32S3
        help
            GPIO number for MOTOR_V
    config FOC_MOTOR_W
        int "MOTOR_W pin number"
        range ENV_GPIO_RANGE_MIN ENV_GPIO_IN_RANGE_MAX
        default 13 if IDF_TARGET_ESP32
        default 40 if IDF_TARGET_ESP32S2 || IDF_TARGET_ESP32S3
        help
            GPIO number for MOTOR_W
    config FOC_MOTOR_EN
        int "MOTOR_EN pin number"
        range ENV_GPIO_RANGE_MIN ENV_GPIO_IN_RANGE_MAX
        default 15 if IDF_TARGET_ESP32
        default 39 if IDF_TARGET_ESP32S2 || IDF_TARGET_ESP32S3
        help
            GPIO number for MOTOR_EN
endmenu
```
